## main/Kconfig.projbuild
```kconfig
menu "Sistema Embarcado"

    choice ESP_MODE
        bool "Selecione o modo de operação da ESP"
        default ESP_MODE_TEMPERATURE
        
        config ESP_MODE_CAR
            bool "Modo de operação de sensor de ré carro"
        config ESP_MODE_MORSE
            bool "Modo de operação de código morse"
        config ESP_MODE_TEMPERATURE
            bool "Modo de operação de temperatura"
    endchoice
endmenu

menu "Configuração do Wifi"

    config ESP_WIFI_SSID
        string "WiFi SSID"
        default "ssid"
        help
            Nome da rede Wifi.

    config ESP_WIFI_PASSWORD
        string "Senha do Wifi"
        default "minha_senha"
        help
            Senha do WiFi (WPA or WPA2).

    config ESP_MAXIMUM_RETRY
        int "Número máximo de tentativas de conexão"
        default 5
        help
            Configure o valor máximo de tentativas de conexão.
endmenu

menu "Modo de Energia"

    choice ESP_ENERGY_OR_LOW_POWER_MODE
        bool "Selecione o modo de energia da placa (energia ou low power)"
        default ESP_ENERGY_MODE
        
        config ESP_ENERGY_MODE
            bool "Modo de funcionamento (Energia)"
        config ESP_LOW_POWER_MODE
            bool "Modo de funcionamento (Low power)"
    endchoice
endmenu

menu "Configuração MQTT"
    config MQTT_BROKER_URI
        string "MQTT broker uri"
        default "mqtt://164.41.98.25"
        help
            Endereço uri do MQTT.

    config MQTT_AUTH_TOKEN
        string "MQTT Auth Token"
        default "8oeUGOP8G1WUbsqnws0B"
        help
            Token de autenticação do MQTT
endmenu
```
